## config/boards/shields/padavan/Kconfig.defconfig
```kconfig
# Copyright (c) 2022 The ZMK Contributors
# SPDX-License-Identifier: MIT

if SHIELD_PADAVAN

config ZMK_KEYBOARD_NAME
    default "padavan"

endif
```
